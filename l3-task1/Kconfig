## l3-task1/Kconfig
```kconfig
menuconfig LED_SUBSYSTEM
    bool "LED Subsystem"
    default y

if LED_SUBSYSTEM

    choice
        prompt "LED blink sleep time"
        default BLINK_SLEEP_1000MS
        help
            Selects blinking period

        config BLINK_SLEEP_250MS
            bool "250ms (very fast)"

        config BLINK_SLEEP_500MS
            bool "500ms (fast)"

        config BLINK_SLEEP_1000MS
            bool "1s (medium)"

        config BLINK_SLEEP_2000MS
            bool "2s (slow)"

    endchoice


    menuconfig ADVANCED_LED_SETTINGS
        bool "Advanced LED settings"
        default n
        help
            When visible allows advanced LED configuration

    if ADVANCED_LED_SETTINGS

        config LED_BRIGHTNESS
            int "LED Brightness (0-100)"
            range 0 100
            default 100
            help
                Selects LED brightness

        config LED_FADE_DURATION
            int "LED Fade Duration (ms)"
            range 0 5000
            default 500
            help
                Selects LED fading duration

        menu "Expert Settings"
            visible if ADVANCED_LED_SETTINGS
            config LED_DEBUG_ENABLE
                bool "Enable LED debugging"
                default n
                help
                    Enables LED debugging

            config LED_CUSTOM_BLINK_PATTERN
                bool "Custom blink pattern"
                default n
                help
                    Enables the use of custom blinking patterns

        endmenu

    endif # ADVANCED_LED_SETTINGS

endif # LED_SUBSYSTEM

config BLINK_SLEEP_TIME_MS
    int
    default 250 if BLINK_SLEEP_250MS
    default 500 if BLINK_SLEEP_500MS
    default 1000 if BLINK_SLEEP_1000MS
    default 2000 if BLINK_SLEEP_2000MS

menu "Configuración de Zephyr"

source "Kconfig.zephyr"

endmenu
```

## l4-task1/Kconfig
```kconfig
menu "Heartbeat LED App"

    config APP_HEARTBEAT_PERIOD_MS
        int "Heartbeat period in miliseconds"
        range 100 2000
        default 500

endmenu

menu "Configuración de Zephyr"

source "Kconfig.zephyr"

endmenu
```

## l5-task1/boards/my_stm32_board/board.yml
```yaml
board:
  name: my_stm32_board
  full_name: My stm32 board
  vendor: st
  socs:
    - name: stm32f446xx
```

## l6-task/boards/my_board/board.yml
```yaml
board:
  name: my_board
  full_name: My board
  vendor: st
  socs:
    - name: stm32f446xx
```

## l6-task/driver/Kconfig
```kconfig
menuconfig MY_DRIVER
    bool "Enable my driver"
    select GPIO
    depends on DT_HAS_MY_DRIVER_SENSOR_ENABLED
    help
        My sensor driver.

if MY_DRIVER
    config MY_DRIVER_INIT_STATE
    bool "Start as high"
    default n

endif # MY_DRIVER
```
